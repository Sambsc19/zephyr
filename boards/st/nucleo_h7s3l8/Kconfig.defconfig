## boards/st/nucleo_h7s3l8/Kconfig.defconfig
```kconfig
# STM32H7S78 DISCOVERY KIT board configuration
#
# Copyright (c) 2024 STMicroelectronics
#
# SPDX-License-Identifier: Apache-2.0
#

if BOARD_NUCLEO_H7S3L8

if NETWORKING

config NET_L2_ETHERNET
	default y

endif # NETWORKING

endif # BOARD_STM32H7S78_DK
```

## samples/drivers/flash_shell/boards/stm32h7s78_dk.conf
```kconfig
CONFIG_HEAP_MEM_POOL_SIZE=8192
# This board only has 64KB FLASH, disable LOG to run in internal flash.
CONFIG_LOG=n
```

## tests/drivers/counter/counter_basic_api/boards/stm32h7s78_dk.conf
```kconfig
# When executing from the external NOR (XiP), userspace will crash
CONFIG_TEST_USERSPACE=n
```
